#include "board.h"
#include "debug.h"
#include "modSysClock.h"


#define GPIO_AVR_RESET        GPIOC
#define GPIO_Pin_AVR_RESET    GPIO_Pin_10
#define GPIO_AVR_CLK          GPIOC
#define GPIO_Pin_AVR_CLK      GPIO_Pin_12
#define GPIO_AVR_MOSI         GPIOD
#define GPIO_Pin_AVR_MOSI     GPIO_Pin_0
#define GPIO_AVR_MISO         GPIOC
#define GPIO_Pin_AVR_MISO     GPIO_Pin_11
//#define GPIO_AVR_CLOCK         GPIOB
//#define GPIO_Pin_AVR_CLOCK     GPIO_Pin_11

#define AVR_RESET_L           (GPIO_AVR_RESET->BSRRH = GPIO_Pin_AVR_RESET)
#define AVR_RESET_H           (GPIO_AVR_RESET->BSRRL = GPIO_Pin_AVR_RESET)
#define AVR_CLK_L             (GPIO_AVR_CLK->BSRRH = GPIO_Pin_AVR_CLK)
#define AVR_CLK_H             (GPIO_AVR_CLK->BSRRL = GPIO_Pin_AVR_CLK)
#define AVR_MOSI_L            (GPIO_AVR_MOSI->BSRRH = GPIO_Pin_AVR_MOSI)
#define AVR_MOSI_H            (GPIO_AVR_MOSI->BSRRL = GPIO_Pin_AVR_MOSI)
//#define AVR_DAT_L             GPIO_ResetBits(GPIO_AVR_DAT, GPIO_Pin_AVR_MISO) 
//#define AVR_DAT_H             GPIO_SetBits(GPIO_AVR_DAT, GPIO_Pin_AVR_MISO)
#define AVR_MISO_IN           (GPIO_AVR_MISO->IDR & GPIO_Pin_AVR_MISO)
// #define AVR_CLOCK_INV      



#define PROG_AVR_DELAY_SPI    _delay_us(5)
//#define PROG_AVR_DELAY_WRITE  _delay_ms(10)
#define PROG_AVR_DELAY_MS(a)  _delay_ms(a)


uint8_t  progAVR_ID[3]; // Байты сигнатуры
uint8_t  progAVR_calibByte[4]; // Байты 

typedef enum {
    ATMEGA16A = 0,
    ATMEGA8A,
    ATMEGA8515,
    ATTINY2313,
    ATTINY13, //! - допроверить
    AT90S2313, //!
    
    AVR_PROG_CHIP_NUM
} PROG_AVR_FUSES;

static const uint8_t progAVR_constID[][3] = {
    {0x1E, 0x94, 0x03}, // ATMEGA16A
    {0x1E, 0x93, 0x07}, // ATMEGA8A
    {0x1E, 0x93, 0x06}, // ATMEGA8515
    {0x1E, 0x91, 0x0A}, // ATTINY2313
    {0x1E, 0x90, 0x07}, // ATTINY13
    {0x1E, 0x91, 0x0A}, // AT90S2313
};
uint16_t progAVR_mcu = 0; // num controller

static const uint8_t progAVR_constFusesDefault[][4] = {
    //fL    fH    LB    ex
    {0xE1, 0x99, 0xFF, 0xFF}, // ATMEGA16A
    {0xE1, 0xD9, 0xFF, 0xFF}, // ATMEGA8A
    {0xE1, 0xD9, 0xFF, 0xFF}, // ATMEGA8515
    {0x64, 0xDF, 0xFF, 0xFF}, // ATTINY2313
    {0x6A, 0xFF, 0xFF, 0xFF}, // ATTINY13 не точно
    {0x64, 0xDF, 0xFF, 0xFF}, // AT90S2313 не точно
};

static const uint16_t progAVR_constFLASHpageSize[] = {
    // Fsize
    64, // ATMEGA16A
    32, // ATMEGA8A
    32, // ATMEGA8515
    16, // ATTINY2313
    16, // ATTINY13!
    16, // AT90S2313!
};

#define PROG_AVR_FLASH_PAGE_MAX_SIZE    64 //256
uint16_t progAVR_FLASH_buf [PROG_AVR_FLASH_PAGE_MAX_SIZE - 0];
uint16_t progAVR_flasgSize = 0;
// fuzes
uint8_t  progAVR_fuzeL;
uint8_t  progAVR_fuzeH;
uint8_t  progAVR_lock;
uint8_t  progAVR_exten;
uint16_t progAVR_calibB;


// Программный спи 
uint8_t progAVR_xspi(uint8_t data) 
{ 
    uint8_t i;

    for (i = 0; i < 8; i++)
    {
        if (data & 0x80)//Выставить бит данных
        {
            AVR_MOSI_H;
        } else {
            AVR_MOSI_L;
        }
        data = data << 1;
        PROG_AVR_DELAY_SPI;
        AVR_CLK_H;
        PROG_AVR_DELAY_SPI;
	    if (AVR_MISO_IN)
        {
            data = data | 0x01;
        }
        AVR_CLK_L;
	    PROG_AVR_DELAY_SPI;
    }
	return data;
}


void progAVR_on_lines(void)
{
    GPIO_InitTypeDef GPIO_InitStructure;
    
    /* Enable Reset GPIO Clock */
    RCC_AHB1PeriphClockCmd(RCC_AHB1Periph_GPIOC, ENABLE);
    RCC_AHB1PeriphClockCmd(RCC_AHB1Periph_GPIOD, ENABLE);
    
    GPIO_StructInit (&GPIO_InitStructure);
    /* LEDs pin configuration -------------------------------------------------*/
    GPIO_InitStructure.GPIO_Pin =  (GPIO_Pin_AVR_CLK | GPIO_Pin_AVR_RESET);
    GPIO_InitStructure.GPIO_Mode = GPIO_Mode_OUT;
    GPIO_InitStructure.GPIO_Speed = GPIO_Speed_50MHz;
    GPIO_InitStructure.GPIO_OType = GPIO_OType_PP;
    GPIO_InitStructure.GPIO_PuPd  = GPIO_PuPd_NOPULL;
    GPIO_Init (GPIOC, &GPIO_InitStructure);
    
    GPIO_StructInit (&GPIO_InitStructure);
    /* LEDs pin configuration -------------------------------------------------*/
    GPIO_InitStructure.GPIO_Pin =  (GPIO_Pin_AVR_MOSI);
    GPIO_InitStructure.GPIO_Mode = GPIO_Mode_OUT;
    GPIO_InitStructure.GPIO_Speed = GPIO_Speed_50MHz;
    GPIO_InitStructure.GPIO_OType = GPIO_OType_PP;
    GPIO_InitStructure.GPIO_PuPd  = GPIO_PuPd_NOPULL;
    GPIO_Init (GPIOD, &GPIO_InitStructure);
    //#todo init MISO
    
    /*
    GPIO_InitTypeDef GPIO_InitStructure;
    
    GPIO_StructInit(&GPIO_InitStructure);
    GPIO_InitStructure.GPIO_Pin   = GPIO_Pin_AVR_RESET |
                                    GPIO_Pin_AVR_CLK   |
                                    GPIO_Pin_AVR_MOSI;
	GPIO_InitStructure.GPIO_Mode  = GPIO_Mode_Out_PP;
	GPIO_InitStructure.GPIO_Speed = GPIO_Speed_10MHz;
	GPIO_Init(GPIOA, &GPIO_InitStructure);
    
    GPIO_StructInit(&GPIO_InitStructure);
    GPIO_InitStructure.GPIO_Pin   = GPIO_Pin_AVR_MISO;
	GPIO_InitStructure.GPIO_Mode  = GPIO_Mode_IPU;//GPIO_Mode_IN_FLOATING;
	GPIO_InitStructure.GPIO_Speed = GPIO_Speed_10MHz;
	GPIO_Init(GPIOA, &GPIO_InitStructure);
    */
}


void progAVR_off_lines (void)
{
    GPIO_InitTypeDef GPIO_InitStructure;
    
    GPIO_StructInit (&GPIO_InitStructure);
    /* LEDs pin configuration -------------------------------------------------*/
    GPIO_InitStructure.GPIO_Pin =  (GPIO_Pin_AVR_CLK | GPIO_Pin_AVR_RESET);
    GPIO_InitStructure.GPIO_Mode = GPIO_Mode_IN;
    GPIO_InitStructure.GPIO_PuPd  = GPIO_PuPd_NOPULL;
    GPIO_Init (GPIOC, &GPIO_InitStructure);
    
    GPIO_StructInit (&GPIO_InitStructure);
    /* LEDs pin configuration -------------------------------------------------*/
    GPIO_InitStructure.GPIO_Pin =  (GPIO_Pin_AVR_MOSI);
    GPIO_InitStructure.GPIO_Mode = GPIO_Mode_IN;
    GPIO_InitStructure.GPIO_PuPd  = GPIO_PuPd_NOPULL;
    GPIO_Init (GPIOD, &GPIO_InitStructure);
    
    /*
    GPIO_InitTypeDef GPIO_InitStructure;
    
    GPIO_StructInit( &GPIO_InitStructure);
    GPIO_InitStructure.GPIO_Pin   = GPIO_Pin_AVR_RESET |
                                    GPIO_Pin_AVR_CLK   |
                                    GPIO_Pin_AVR_MISO  |
                                    GPIO_Pin_AVR_MOSI;
	GPIO_InitStructure.GPIO_Mode  = GPIO_Mode_IN_FLOATING;
	GPIO_InitStructure.GPIO_Speed = GPIO_Speed_50MHz;
	GPIO_Init(GPIOA, &GPIO_InitStructure);
    */
}


msg_t progAVR_progammingEnable(void)
{
    msg_t respond = FUNCTION_RETURN_ERROR;
    uint8_t t8;
                
    AVR_RESET_H;
    PROG_AVR_DELAY_MS(10);
    AVR_RESET_L;
    PROG_AVR_DELAY_MS(10);
    
    progAVR_xspi(0xAC);
    progAVR_xspi(0x53);
    t8 = progAVR_xspi(0xFF);
    if (t8 == 0x53)
        respond = FUNCTION_RETURN_OK;
    t8 = progAVR_xspi(0xFF);
    
    return respond;
}


msg_t progAVR_readID(void)
{
    msg_t respond = FUNCTION_RETURN_ERROR;
    uint16_t i;
    
    for (i = 0; i < 3; i++)
    {
        progAVR_xspi(0x30);
        progAVR_xspi(0x00);
        progAVR_xspi((uint8_t)i & 0x03);
        progAVR_ID[i] = progAVR_xspi(0xFF);
    }
    // Searching...
    for (i = 0; i < AVR_PROG_CHIP_NUM; i++) // @todo 3
    {
        if ((progAVR_ID[0] == progAVR_constID[i][0]) && \
            (progAVR_ID[1] == progAVR_constID[i][1]) && \
            (progAVR_ID[2] == progAVR_constID[i][2]))
        {
            progAVR_flasgSize = progAVR_constFLASHpageSize[i];
            progAVR_mcu = i;
            respond = FUNCTION_RETURN_OK;
        }
    }
    
    return respond;
}


void progAVR_erase_all (void) // FLASH+EEPROM
{
    progAVR_xspi(0xAC);
    progAVR_xspi(0x80);
    progAVR_xspi(0x00);
    progAVR_xspi(0x00);
    PROG_AVR_DELAY_MS(20);
}



void progAVR_FUSE_read (void)
{
    progAVR_xspi(0x50);
    progAVR_xspi(0x00);
    progAVR_xspi(0x00);
    progAVR_fuzeL = progAVR_xspi(0xFF);

    progAVR_xspi(0x58);
    progAVR_xspi(0x08);
    progAVR_xspi(0x00);
    progAVR_fuzeH = progAVR_xspi(0xFF);
    
    progAVR_xspi(0x58);
    progAVR_xspi(0x00);
    progAVR_xspi(0x00);
    progAVR_lock = progAVR_xspi(0xFF);
    
    progAVR_xspi(0x50);
    progAVR_xspi(0x08);
    progAVR_xspi(0x00);
    progAVR_exten = progAVR_xspi(0xFF);
    
//     // calib
//     progAVR_xspi(0x38);
//     progAVR_xspi(0x00);
//     progAVR_xspi(0x01);
//     progAVR_calibB = progAVR_xspi(0xFF);
//     progAVR_calibB =  progAVR_calibB << 8;
//             
//     progAVR_xspi(0x38);
//     progAVR_xspi(0x00);
//     progAVR_xspi(0x00);
//     progAVR_calibB |= progAVR_xspi(0xFF);
}


msg_t progAVR_FUSE_restore (void)
{
    msg_t respond = FUNCTION_RETURN_ERROR;
    uint8_t i;

    progAVR_erase_all();
    PROG_AVR_DELAY_MS(10); // x10
    
    progAVR_xspi(0xAC);
    progAVR_xspi(0xA0);
    progAVR_xspi(0x00); // //progAVR_fuzeL
    progAVR_xspi(progAVR_constFusesDefault[progAVR_mcu][0]);
    PROG_AVR_DELAY_MS(10);
    
//     progAVR_xspi(0xAC);
//     progAVR_xspi(0xA8);
//     progAVR_xspi(0x00); //progAVR_fuzeH
//     progAVR_xspi(progAVR_constFusesDefault[progAVR_mcu][1]);
//     PROG_AVR_DELAY_WRITE;

//     progAVR_xspi(0xAC);
//     progAVR_xspi(0xFF);
//     progAVR_xspi(0x00); // progAVR_lock
//     progAVR_xspi(progAVR_constFusesDefault[progAVR_mcu][2]);
//     PROG_AVR_DELAY_WRITE;

//     progAVR_xspi(0xAC);
//     progAVR_xspi(0xA4);
//     progAVR_xspi(0x00); // progAVR_exten 
//     progAVR_xspi(progAVR_constFusesDefault[progAVR_mcu][3]);
//     PROG_AVR_DELAY_WRITE;

    return respond;
}


msg_t progAVR_FUSE_write (void)
{
    msg_t respond = FUNCTION_RETURN_ERROR;
    uint8_t i;

    //progAVR_eraseAll();
    //PROG_AVR_DELAY_MS(10);; // x10
    
    progAVR_xspi(0xAC);
    progAVR_xspi(0xA0);
    progAVR_xspi(0x00); // //
    progAVR_xspi(progAVR_fuzeL);
    PROG_AVR_DELAY_MS(10);
    
    progAVR_xspi(0xAC);
    progAVR_xspi(0xA8);
    progAVR_xspi(0x00); //
    progAVR_xspi(progAVR_fuzeH);
    PROG_AVR_DELAY_MS(10);

    progAVR_xspi(0xAC);
    progAVR_xspi(0xFF);
    progAVR_xspi(0x00); // progAVR_lock
    progAVR_xspi(progAVR_lock);
    PROG_AVR_DELAY_MS(10);

//     progAVR_xspi(0xAC);
//     progAVR_xspi(0xA4);
//     progAVR_xspi(0x00); // progAVR_exten 
//     progAVR_xspi(progAVR_constFusesDefault[progAVR_mkType][3]);
//     PROG_AVR_DELAY_MS(10);

    return respond;
}


//uint8_t progAVR_dataEEPROM;
void  progAVR_readEEPROM (uint16_t adress, uint8_t *buf)
{
    progAVR_xspi(0xA0);
    progAVR_xspi(adress >> 8);
    progAVR_xspi(adress & 0xFF);
    *buf = progAVR_xspi(0xFF);
}


msg_t progAVR_writeEEPROM (uint16_t adress, uint8_t buf)
{
    msg_t respond = FUNCTION_RETURN_ERROR;
    uint8_t tmp8 = 0;
    
    progAVR_xspi(0xC0);
    progAVR_xspi(adress >> 8);
    progAVR_xspi(adress & 0xFF);
    progAVR_xspi(buf);
    PROG_AVR_DELAY_MS(10);
    progAVR_readEEPROM(adress, &tmp8);
    if (buf == tmp8)
        return FUNCTION_RETURN_OK;
    return respond;
}


msg_t progAVR_FLASH_byte_read (uint16_t adress, uint16_t *buf)
{
    msg_t respond = FUNCTION_RETURN_ERROR;
    uint16_t i;
    
    for (i = 0; i < progAVR_constFLASHpageSize[progAVR_mcu]; i++)
    {
        progAVR_xspi(0x28);
        progAVR_xspi((adress + i) >> 8);
        progAVR_xspi((adress + i) & 0xFF);
        buf[i] = progAVR_xspi(0xFF);
        
        buf[i] =  buf[i] << 8;
        
        progAVR_xspi(0x20);
        progAVR_xspi((adress + i) >> 8);
        progAVR_xspi((adress + i) & 0xFF);
        buf[i] |= progAVR_xspi(0xFF);
    }

    return respond;
}


msg_t progAVR_FLASH_page_write (uint16_t adress, uint16_t *buf)
{
    msg_t respond = FUNCTION_RETURN_ERROR;
    uint8_t i; //@todo 16bit?

    for (i = 0; i < progAVR_constFLASHpageSize[progAVR_mcu]; i++)
    {
        progAVR_xspi(0x40);
        progAVR_xspi(0x00);
        progAVR_xspi(i & 0xFF);
        progAVR_xspi(buf[i] & 0xFF);
        
        progAVR_xspi(0x48);
        progAVR_xspi(0x00);
        progAVR_xspi(i & 0xFF);
        progAVR_xspi(buf[i] >> 8);
    }
    adress = adress * progAVR_constFLASHpageSize[progAVR_mcu];
    progAVR_xspi(0x4C);
    progAVR_xspi(adress >> 8);
    progAVR_xspi(adress & 0xFF);
    progAVR_xspi(0x00); // 0xFF???
    
    PROG_AVR_DELAY_MS(20);

    return respond;
}


#include "modPaint.h"
#include "xprintf.h"
extern char _str [256]; // буфер строки на вывод


msg_t progAVR_init (void)
{
    msg_t respond = FUNCTION_RETURN_ERROR;
    
    AVR_RESET_H;
    AVR_CLK_L;
    AVR_MOSI_L;
    _delay_ms(2);
    AVR_RESET_L;
    progAVR_on_lines();
    _delay_ms(2);
    if (FUNCTION_RETURN_OK == progAVR_progammingEnable())
    {
        paint_putStrColRow (0, 5, (char *)"AVR CONNECT");
        if (FUNCTION_RETURN_OK == progAVR_readID())
        {
            xsprintf(_str, "ID:%02X:%02X:%02X", progAVR_ID[0], progAVR_ID[1], progAVR_ID[2]);
            paint_putStrColRow (0, 6, _str);
            respond = FUNCTION_RETURN_OK;
        }
    }
    else
    {
        paint_putStrColRow (0, 5, (char *)"AVR NOT CONNECT");
    }
    
    return respond;
}


#include "conv.h"

#define BOOT_ATMEGA16A 0
#define BOOT_ATMEGA8A 0
#define BOOT_ATMEGA8515 1

static const uint8_t pHEX[] = {
#if BOOT_ATMEGA8515
"\
:1000000039C01DC752C051C050C04FC04EC04DC0B6\
:100010004CC04BC04AC049C048C047C046C045C09C\
:1000200044C0040309041C037700770077002E0006\
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:10108000006111B31B7E402F4B7E5F9100C000C0FA\
:0C10900002BB11BB42BB7CCFF894FFCF29\
:02109C005AFFF9\
:00000001FF\
"
#endif
    
#if BOOT_ATMEGA16A
"\
:103800000C94681C0C94A01C0C94851C0C94851CB6\
:103810000C94851C0C94851C0C94851C0C94851CA4\
:103820000C94851C0C94851C0C94851C0C94851C94\
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:103880000008C016DF050001010200010902220044\
:103890000101008032090400000103000000092139\
:1038A00001010001222100070581030800C806006C\
:1038B000FF0901A101150026FF0075088501950685\
:1038C0000900B20201850295830900B20201C0001D\
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:103F3000099520E017968C911797882309F42BCFC9\
:063F40002ECFF894FFCF24\
:0A3F46005AFF018000004000000057\
:0400000300003800C1\
:00000001FF\
\
"
#endif

#if BOOT_ATMEGA8A
"\
:1018000050C084C069C068C067C066C065C064C09D\
:1018100063C062C061C060C05FC05EC05DC05CC0CC\
:101820005BC05AC059C00403090412036F00620070\
:101830006400650076002E0061007400100348000B\
:101840004900440042006F006F0074001201100153\
:1018500000000008C016DF050001010200010902B6\
:101860002200010100803209040000010300000091\
:10187000092101010001222100070581030800C898\
:101880000600FF0901A101150026FF00750885016A\
:1018900095060900B20201850295830900B2020192\
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:101F000017968C911797882309F42CCF2FCFF8942C\
:021F1000FFCF01\
:0A1F12005AFF01400000200000000B\
:00000001FF\
\
" //был удален выше кусок!!! - :0400000300001800E1
/*
"\
:100000000C942A000C9434000C9434000C943400AA\
:100010000C9434000C9434000C9434000C94340090\
:100020000C9434000C9434000C9434000C94340080\
:100030000C9434000C9434000C9434000C94340070\
:100040000C9434000C9434000C9434000C94340060\
:100050000C94340011241FBECFE5D4E0DEBFCDBF29\
:100060000E943C000C944C000C940000B89AC09A7A\
:100070000895B89AC0980895B89A41E02CE231E00A\
:1000800088B3842788BB8CE291E0F9013197F1F7BE\
:0C0090000197D9F7A895F4CFF894FFCFA2\
:00000001FF\
"*/
#endif
};



uint16_t parserHEX_buf [PROG_AVR_FLASH_PAGE_MAX_SIZE];



// https://ru.wikipedia.org/wiki/Intel_HEX
#include "hal.h"

uint8_t *progAVR_cntbt;
msg_t progAVR_get_c (uint8_t *byte)
{
    msg_t resp = FUNCTION_RETURN_ERROR;
    if (NULL != progAVR_cntbt)
    {
        if ('\0' != progAVR_cntbt)
        {
            *byte = *progAVR_cntbt;
            progAVR_cntbt++;
            resp = FUNCTION_RETURN_OK;
        }
    }
    return resp;
}


msg_t progAVR_get_byte (uint8_t *byte)
{
    msg_t resp = FUNCTION_RETURN_ERROR;
    uint8_t tmpH, tmpL;
    
    if (FUNCTION_RETURN_OK == progAVR_get_c (&tmpH))
    {
        if (FUNCTION_RETURN_OK == progAVR_get_c (&tmpL))
        {
            *byte = (char2hex(tmpH) << 4) | char2hex(tmpL);
            resp = FUNCTION_RETURN_OK;
        }
    }
    return resp;
}



    
msg_t progAVR_go (void)
{
    msg_t resp = FUNCTION_RETURN_ERROR;
    uint32_t i, j, size;
    uint8_t tmp8, tmp_c;
    uint16_t tmp16;
    uint16_t cnt_out = 0;
    
    uint8_t  length;
    uint16_t address; //32!
    uint8_t  type;
    uint8_t  checksum;
    uint16_t adr_write = 0;
    
    progAVR_cntbt = (uint8_t *)&pHEX[0];
    
    _debug_out((char *)"Start AVR programming...\n");
    if (FUNCTION_RETURN_ERROR != progAVR_init())
    {

        for (i = 0; i < 4; i++)
        {
            progAVR_xspi(0x38);
            progAVR_xspi(0x00);
            progAVR_xspi((uint8_t)i & 0x03);
            progAVR_calibByte[i] = progAVR_xspi(0xFF); // read calib byte
            //1 - 0xBD
            //2 - 0xBD
            //3 - 0xB9
            //4 - 0xBA
            
            //0x3E
            //0x38
            //0xFF
            //0xFF
        }
        xsprintf(_str, "CLB:%02X:%02X:%02X:%02X", progAVR_calibByte[0], progAVR_calibByte[1], progAVR_calibByte[2], progAVR_calibByte[3]);
        paint_putStrColRow (0, 7, _str);
    
        //return 0;
        progAVR_erase_all();
    
        //clear all
        if (ATMEGA16A == progAVR_mcu)
        {
            adr_write = 112; // for boot
        }
        else if (ATMEGA8A == progAVR_mcu)
        {
            adr_write = 96;//192;
        }
        else
        {
            adr_write = 0;
        }
        checksum = 0;
        cnt_out = 0;
        
//         for (i = 0; i < 64*2; i++)
//         {
//             uint8_t *pn = (uint8_t *)progAVR_FLASH_buf;
//             pn[i] = i;
//         }
//         progAVR_FLASH_page_write (0, &progAVR_FLASH_buf[0]);

        for (i = 0; i < progAVR_constFLASHpageSize[progAVR_mcu]; i++) // чистим буфер FLASH
        {
            progAVR_FLASH_buf[i] = 0xFFFF;
        }
        
        while (1) //декодируем 
        {
            if (FUNCTION_RETURN_ERROR == progAVR_get_c(&tmp8))
                break;
            if (':' == tmp8)
            {
                checksum = 0;
                
                // loading parameters
                if (FUNCTION_RETURN_ERROR == progAVR_get_byte(&tmp8))
                    break;
                length = tmp8 / 2; // in words (16 bits)
                //checksum += tmp8;
                
                if (FUNCTION_RETURN_ERROR == progAVR_get_byte(&tmp8))
                    break;
                checksum += tmp8;
                address = (uint16_t )tmp8 << 8;
                if (FUNCTION_RETURN_ERROR == progAVR_get_byte(&tmp8))
                    break;
                checksum += tmp8;
                address |= tmp8;

                if (FUNCTION_RETURN_ERROR == progAVR_get_byte(&tmp8))
                    break;
                checksum += tmp8;
                type = tmp8;

                if (0x00 != type) //EOF
                {
                    break;
                }
                else
                {
                    // reading data !!!!!!!!!!!!!!! bytes not operated for normel orient!!!!!!!!!
                    //checksum = 0;
                    for (i = 0; i < length; i++) // 8 iterations max
                    {
                        tmp16 = 0;
                        if (FUNCTION_RETURN_ERROR == progAVR_get_byte(&tmp8))
                            break;
                        checksum += tmp8;
                        tmp16 |= (uint16_t)tmp8 ;
                        if (FUNCTION_RETURN_ERROR == progAVR_get_byte(&tmp8))
                            break;
                        checksum += tmp8;
                        tmp16 |= (uint16_t)tmp8 << 8;
                        progAVR_FLASH_buf [cnt_out + i] = tmp16;
                        
                    }
                    cnt_out += length;
                }
                // check crc
                if (FUNCTION_RETURN_ERROR == progAVR_get_byte(&tmp8))
                    break;

                tmp8 = 0 - tmp8;
                //if (checksum != (0 - tmp8))
                //    break;
                
                if (cnt_out >= progAVR_constFLASHpageSize[progAVR_mcu])
                {
                    cnt_out = 0;
                    progAVR_FLASH_page_write (adr_write, &progAVR_FLASH_buf[0]);
                    for (i = 0; i < progAVR_constFLASHpageSize[progAVR_mcu]; i++)
                    {
                        progAVR_FLASH_buf[i] = 0xFFFF;
                    }
                    adr_write++;
                }
            }

        }
        // writing остаток!
        progAVR_FLASH_page_write (adr_write, &progAVR_FLASH_buf[0]);
        
        //check
        i = 0;
        for (; i < 12; i++)
        {
            progAVR_FLASH_byte_read (i * 8, &tmp16);
            progAVR_FLASH_buf[i] = tmp16;
            //dprintf(("%04x", tmp16));
            xsprintf(_str, "%04x", tmp16);
            _debug_out(_str);
            paint_putStrColRow (0, 8 + i, _str);
        }
        if (ATMEGA16A == progAVR_mcu)
        {
            progAVR_fuzeL = 0xEF;
            progAVR_fuzeH = 0xD0; // jtag-off, boot-on
            progAVR_lock  = 0xEF;
        }
        else if (ATTINY13 == progAVR_mcu)
        {
            progAVR_fuzeL = 0x7A; // div8-off
            progAVR_fuzeH = 0xFF; //
            progAVR_lock  = 0xFF; 
        }
        else if (ATMEGA8A == progAVR_mcu)
        {
            progAVR_fuzeL = 0xEF;
            progAVR_fuzeH = 0xD8; //
            progAVR_lock  = 0xFF; 
        }
        else if (ATMEGA8515 == progAVR_mcu)
        {
            progAVR_fuzeL = 0xEF; //0xE1;
            progAVR_fuzeH = 0xC9; //
            progAVR_lock  = 0xFF; 
        }
        else
        {
            while(1){};
        }
        //while(1){};
        progAVR_FUSE_write ();
        progAVR_FUSE_read();
        xsprintf(_str, "L%02X H%02X K%02X E%02X", 
            progAVR_fuzeL,
            progAVR_fuzeH,
            progAVR_lock,
            progAVR_exten);
        paint_putStrColRow (0, 3, _str);

        resp = FUNCTION_RETURN_OK;
    }
    progAVR_off_lines ();
    return resp;
}
